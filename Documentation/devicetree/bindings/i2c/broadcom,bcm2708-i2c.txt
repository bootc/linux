## Documentation/devicetree/bindings/i2c/broadcom,bcm2708-i2c.txt
```
* Broadcom BCM2708 BSC driver

This is used on the Raspberry Pi with the Broadcom BCM2835 SoC. Broadcom Serial
Controller is a Broadcom proprietary bus compatible with I2C.

Required properties:
- compatible : Should be "broadcom,bcm2708-i2c"
- reg : Should contain BSC register base and length
- interrupt-parent : Should point to an interrupt controller
- interrupts : Should contain the BSC interrupt number
- #address-cells : Must be 1
- #size-cells : Must be 0

Optional properties:
- clock-frequency : Constains desired I2C/BSC bus clock frequency in Hz.
  The absence of the propoerty indicates the default frequency 100 kHz.
- Child nodes conforming to i2c bus binding

Examples:

bsc0 {
	#address-cells = <1>;
	#size-cells = <0>;
	compatible = "broadcom,bcm2708-i2c";
	reg = <0x20205000 0x18>;
	interrupt-parent = <&vic2>;
	interrupts = <21>;
};
```

## Documentation/devicetree/bindings/spi/broadcom,bcm2708-spi.txt
```
* Broadcom BCM2708 SPI driver

This is used on the Raspberry Pi with the Broadcom BCM2835 SoC.

Required properties:
- compatible : Should be "broadcom,bcm2708-spi"
- reg : Should contain SPI register base and length
- interrupt-parent : Should point to an interrupt controller
- interrupts : Should contain the BSC interrupt number
- #address-cells : Must be 1
- #size-cells : Must be 0

Optional properties:
- linux,realtime : Boolean property that makes the SPI message pump run with
  realtime priority
- Child nodes conforming to spi bus binding

Examples:

spi {
	#address-cells = <1>;
	#size-cells = <0>;
	compatible = "broadcom,bcm2708-spi";
	reg = <0x20204000 0x18>;
	interrupt-parent = <&vic2>;
	interrupts = <22>;
};
```

## drivers/target/sbp/Kconfig
```kconfig
config FIREWIRE_SBP_TARGET
	tristate "FireWire SBP-2 fabric module"
	depends on TARGET_CORE && CONFIGFS_FS && FIREWIRE && EXPERIMENTAL
	default n
	help
	  Say Y or M here to enable SCSI target functionality over FireWire.
	  This enables you to expose SCSI devices to other nodes on the FireWire
	  bus, for example hard disks. Similar to FireWire Target Disk mode on
	  older Apple computers.

	  To compile this driver as a module, say M here: The module will be
	  called firewire-sbp-target.
```

## drivers/target/usb-gadget/Kconfig
```kconfig
config TCM_USB_GADGET
	tristate "USB Gadget Fabric Module"
	depends on USB_GADGET
	---help---
	This fabric is an USB gadget. Two USB protocols are supported that is
	BBB or BOT (Bulk Only Transport) and UAS (USB Attached SCSI). BOT is
	advertised on alternative interface 0 (primary) and UAS is on
	alternative interface 1. Both protocols can work on USB2.0 and USB3.0.
	UAS utilizes the USB 3.0 feature called streams support.
```
